## br2miyoomini/board/miyoo/miyoomini/kernel.its
```
/dts-v1/;

/ {
	description = "Miyoo Mini";
	#address-cells = <1>;

	images {
		kernel-0 {
			data = /incbin/("../../images/zImage");
			type = "kernel";
			arch = "arm";
			os = "linux";
			compression = "none";
			load = <0x20000000>;
            entry = <0x20000000>;
			hash-1 {
				algo = "crc32";
			};
			hash-2 {
				algo = "sha1";
			};
		};
		fdt-0 {
			data = /incbin/("../../images/mstar-infinity2m-ssd202d-miyoo-mini.dtb");
			type = "flat_dt";
			arch = "arm";
			compression = "none";
			hash-1 {
				algo = "crc32";
			};
			hash-2 {
				algo = "sha1";
			};
		};
	};

	configurations {
		default = "midrived06";
		midrived06 {
			kernel = "kernel-0";
			fdt = "fdt-0";
		};
	};
};
```

## br2miyoomini/configs/miyoomini_defconfig
```kconfig
BR2_arm=y
BR2_cortex_a7=y
BR2_ARM_FPU_NEON_VFPV4=y
BR2_RELRO_NONE=y
BR2_FORTIFY_SOURCE_NONE=y
BR2_TOOLCHAIN_BUILDROOT_GLIBC=y
BR2_BINUTILS_VERSION_2_41_X=y
BR2_GCC_VERSION_12_X=y
BR2_TOOLCHAIN_BUILDROOT_CXX=y
BR2_GCC_ENABLE_LTO=y
BR2_TARGET_GENERIC_HOSTNAME="miyoomini"
BR2_TARGET_GENERIC_ISSUE="Welcome to MiyooMini"
BR2_ROOTFS_USERS_TABLES="$(BR2_EXTERNAL_MIYOOMINI_PATH)/users"
BR2_ROOTFS_OVERLAY="$(BR2_EXTERNAL_MIYOOMINI_PATH)/board/miyoo/miyoomini/overlay/"
BR2_ROOTFS_POST_IMAGE_SCRIPT="support/scripts/genimage.sh"
BR2_ROOTFS_POST_SCRIPT_ARGS="-c $(BR2_EXTERNAL_MIYOOMINI_PATH)/board/miyoo/miyoomini/genimage.cfg"
BR2_LINUX_KERNEL=y
BR2_LINUX_KERNEL_CUSTOM_GIT=y
BR2_LINUX_KERNEL_CUSTOM_REPO_VERSION="mstar_v6_5_rebase_miyoo_hack"
BR2_LINUX_KERNEL_CUSTOM_REPO_URL="https://github.com/miyoo-oss/linux.git"
BR2_LINUX_KERNEL_USE_CUSTOM_CONFIG=y
BR2_LINUX_KERNEL_CUSTOM_CONFIG_FILE="$(BR2_EXTERNAL_MIYOOMINI_PATH)/board/miyoo/miyoomini/linux.config"
BR2_LINUX_KERNEL_XZ=y
BR2_LINUX_KERNEL_INTREE_DTS_NAME="sigmastar/mstar-infinity2m-ssd202d-miyoo-mini"
BR2_LINUX_KERNEL_DTB_OVERLAY_SUPPORT=y
BR2_LINUX_KERNEL_NEEDS_MSTAR_WORKAROUND=y
BR2_PACKAGE_EXFATPROGS=y
BR2_PACKAGE_MTD=y
BR2_PACKAGE_CHOCOLATE_DOOM=y
BR2_PACKAGE_SDL2_DIRECTFB=y
BR2_PACKAGE_ALSA_LIB=y
BR2_PACKAGE_OPENAL=y
BR2_PACKAGE_ZLIB_NG=y
BR2_PACKAGE_LIBEVENT=y
BR2_TARGET_ROOTFS_CPIO=y
BR2_TARGET_ROOTFS_CPIO_GZIP=y
BR2_TARGET_ROOTFS_SQUASHFS=y
BR2_TARGET_ROOTFS_SQUASHFS4_LZ4=y
BR2_TARGET_UBOOT=y
BR2_TARGET_UBOOT_BUILD_SYSTEM_KCONFIG=y
BR2_TARGET_UBOOT_CUSTOM_GIT=y
BR2_TARGET_UBOOT_CUSTOM_REPO_URL="https://github.com/fifteenhex/u-boot.git"
BR2_TARGET_UBOOT_CUSTOM_REPO_VERSION="mstar_rebase_mainline"
BR2_TARGET_UBOOT_BOARD_DEFCONFIG="mercury5"
BR2_TARGET_UBOOT_NEEDS_DTC=y
BR2_TARGET_UBOOT_NEEDS_PYTHON3=y
BR2_TARGET_UBOOT_FORMAT_IMG=y
BR2_TARGET_UBOOT_SPL=y
BR2_TARGET_UBOOT_SPL_NAME="ipl"
BR2_PACKAGE_HOST_CMAKE=y
BR2_PACKAGE_HOST_DOSFSTOOLS=y
BR2_PACKAGE_HOST_MTOOLS=y
BR2_PACKAGE_HOST_UBOOT_TOOLS_ENVIMAGE=y
BR2_PACKAGE_HOST_UBOOT_TOOLS_ENVIMAGE_SOURCE="$(BR2_EXTERNAL_MIDRIVE08_PATH)/board/70mai/midrive08/uboot.env.in"
BR2_PACKAGE_HOST_UBOOT_TOOLS_ENVIMAGE_SIZE="0x2000"
BR2_MIYOOMINI=y
BR2_PACKAGE_SANETIME=y
BR2_PACKAGE_MEDNAFEN=y
BR2_PACKAGE_DIRECTFB2=y
BR2_PACKAGE_DIRECTFB2_MULTI=y
BR2_PACKAGE_DIRECTFB2_DRMKMS=y
BR2_PACKAGE_ALSA_UTILS=y
BR2_PACKAGE_ALSA_UTILS_ALSAMIXER=y
BR2_PACKAGE_ALSA_UTILS_APLAY=y
BR2_PACKAGE_WPA_SUPPLICANT=y
BR2_CCACHE=y
```

## br2retroarch/Config.in
```kconfig
source "$BR2_EXTERNAL_RETROARCH_PATH/package/retroarch/Config.in"
source "$BR2_EXTERNAL_RETROARCH_PATH/package/libretro-pcsx_rearmed/Config.in"
```

## br2retroarch/package/libretro-pcsx_rearmed/Config.in
```kconfig
config BR2_PACKAGE_LIBRETRO_PCSX_REARMED
	bool "libretro-pcsx_rearmed"
	depends on BR2_PACKAGE_RETROARCH
	depends on BR2_INSTALL_LIBSTDCPP
	help
	  A libretro psx emulator core for ARM.

	  http://www.libretro.com

comment "LIBRETRO_PCSX_REARMED needs a toolchain w/ C++"
	depends on !BR2_INSTALL_LIBSTDCPP
```
